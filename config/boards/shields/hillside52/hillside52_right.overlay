/*
 * Copyright (c) 2021-2022 The ZMK Contributors
 *
 * SPDX-License-Identifier: MIT
 */

#include "hillside52.dtsi" 

&default_transform {
    col-offset = <6>;
};

&kscan0 {
    row-gpios =
        <&pro_micro 5 (GPIO_ACTIVE_HIGH | GPIO_PULL_DOWN)>,
        <&gpio1    39 (GPIO_ACTIVE_HIGH | GPIO_PULL_DOWN)>,  /* row0: P1.07 ("107") */
        <&pro_micro 7 (GPIO_ACTIVE_HIGH | GPIO_PULL_DOWN)>,
        <&pro_micro 8 (GPIO_ACTIVE_HIGH | GPIO_PULL_DOWN)>,
        <&pro_micro 9 (GPIO_ACTIVE_HIGH | GPIO_PULL_DOWN)>;

    col-gpios
        = <&pro_micro 10 GPIO_ACTIVE_HIGH> // col5 in the schematic
        , <&pro_micro 16 GPIO_ACTIVE_HIGH> // col4 in the schematic
        , <&pro_micro 14 GPIO_ACTIVE_HIGH> // col3 in the schematic
        , <&pro_micro 15 GPIO_ACTIVE_HIGH> // col2 in the schematic
        , <&pro_micro 18 GPIO_ACTIVE_HIGH> // col1 in the schematic
        , <&pro_micro 19 GPIO_ACTIVE_HIGH> // col0 in the schematic
        ;
};

&right_encoder {
    status = "okay";
};
